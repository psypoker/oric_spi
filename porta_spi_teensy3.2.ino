#include "pgmspace.h"
#include "core_pins.h"
#include <SD.h>
#include <SPI.h>

//TODOLIST

// .TAP !!!
// => BLOCS !!! et BASIC / ASM ? AUTORUN ! / auto HIRES si start = a000

// .EXE !!!
// .COM !!!
// .IMG !!!
// .PIC !!!
// MENU
// TextPage


File root;
File myFile;
const int chipSelect = 10;

int m = 4;

#define TRACE 0
#define  _SS   2
#define  _MOSI 3
#define  _SCLK 4
#define  _MISO 5

#define SS_SELECT LOW
#define SS_DESELECT HIGH

#define SCLK_HIGH HIGH
#define SCLK_LOW LOW

int ana = 1;
unsigned int count = 0;
long total_bytes = 0;
long total_dirs = 0;
long total_files = 0;

unsigned int crc = 0;

byte sendbuffer[256];
char stringbuff[256];

// buffer de lecture SD why not 256 ???
uint8_t linebuffer[200];
void printBauds(unsigned long t, unsigned long n)
{
	double num = 8000000.0*n;
	num = num / (double)t;
	Serial.print("BAUDS=");
	Serial.println(num);
}
unsigned long t = micros();

void trace(String s)
{

	Serial.print("["); Serial.print(micros()); Serial.print("]");
	Serial.print("["); Serial.print(micros() - t); Serial.print("] ");
	Serial.println(s);
	t = micros();
}
// teensy is SLAVE
inline void setSlaveReady(boolean ready)
{


	sendByte(0x00);
	if (ready)
		sendByte(0x55);
	else
		sendByte(0xff);

}

//// teensy (slave) -> oric (master) bit 7 en premier !
inline void writeByte(byte b)
{
	for (int i = 0; i < 8; i++)
	{
		while (!digitalRead(_SCLK) && !digitalRead(_SS)); // wait SCLK==1 ? (master ask for a new bit)
		if (b & 128)
			digitalWrite(_MISO, HIGH);
		else
			digitalWrite(_MISO, LOW); // 0-4 uS
		b <<= 1;
		while (digitalRead(_SCLK) && !digitalRead(_SS)); // wait SCLK==0 ? (bit read by master)
	}

}


// oric (master) -> teensy (slave) bit 7 en premier !
inline byte readByte()
{
	byte b = 0;
	for (int i = 0; i < 8; i++)
	{
		while (!digitalRead(_SCLK) && !digitalRead(_SS));
		b <<= 1;			// ou >>=1 !!!!????????????
		b |= digitalRead(_MOSI);
		// wait sclk == 1
		while (digitalRead(_SCLK) && !digitalRead(_SS));
	}
	return b;
}

unsigned char oric_screen[8000];

void drawPixel(int x, int y, int c)
{

	int x6 = x % 6;

	//oric_screen[y * 40 + x / 6] |= 1 << (5 - x6);
	oric_screen[y * 40 + x / 6] = c + 16;

}

int Mand(double c_real, double c_imag)
{

	double cx, cy, xsq, ysq;
	int iter;

	cx = c_real + c_real * c_real - c_imag * c_imag;
	cy = c_imag + c_real * c_imag + c_real * c_imag;

	for (iter = 0; iter < 8 && (ysq = cy * cy) + (xsq = cx * cx) < 4; iter++, cy = c_imag + cx * cy + cx * cy, cx = c_real - ysq + xsq);
	return (iter);
}


void mandel()
{
	unsigned long t0 = micros();
	double xmin = -1.5;
	double xmax = 0.5;
	double ymin = -1.25;
	double ymax = 1.25;
	const int w = 240;
	const int h = 200;
	double dx = (xmax - xmin) / w;
	double dy = (ymax - ymin) / h;

	for (int i = 0; i < 8000; i++)
	{
		oric_screen[i] = 0x40;
	}


	for (int i = 0; i < w; i += 6) {
		for (int j = 0; j < h; j++) {
			int n = Mand(xmin + i * dx, ymin + j * dy);
			drawPixel(i, j, n % 8);
		}
	}
	trace(micros() - t0);
}


#if TRACE 


void trace2()
{
	int a;
	for (int i = 0; i < m; i++)
	{
		a = digitalRead(2 + i);
		Serial.print((a + i) * 1024);
		Serial.print(",");
		//	Serial.print(a);
		//	Serial.print(",");
	}
	Serial.println("");

	//	Serial.println("0,1024,2048,3072,4096");
}

#endif




// progmem test image
const byte PROGMEM img[8000] = {
	0x40, 0x40, 0x40, 0x40, 0x00, 0x04, 0x00, 0x04, 0x00, 0x03, 0x41, 0x55,
	0x55, 0x55, 0x55, 0x55, 0xE0, 0x75, 0x55, 0x55, 0x55, 0x58, 0x40, 0x40,
	0x40, 0x40, 0x40, 0x40, 0x40, 0x40, 0x40, 0x42, 0x6F, 0x7D, 0x00, 0x7F,
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	0x40, 0x40, 0x44, 0x48, 0x4A, 0x68, 0x40, 0x01
};


// send & receive operations are transactionnal (wait for slave ready/select/deselect)
// write & read operations are not transactionnal !

inline void wait_select()
{

	while (digitalRead(_SS) != SS_SELECT);


}
inline void wait_deselect()
{

	while (digitalRead(_SS) != SS_DESELECT);

}


unsigned int sendData(const byte *data, int size, bool progmem)
{
	// trace("sending " + String(size) + " bytes from address " + String((unsigned long)data, HEX));

	if (progmem) // progmem -> sendbuffer -> oric
	{
		for (int i = 0; i < size; i++)
		{
			byte b = pgm_read_byte(data + i);

			crc += b;
			sendbuffer[i] = b;
		}
		setSlaveReady(true);
		wait_select();
		for (int i = 0; i < size; i++)
		{
			if (digitalRead(_SS)) {
				trace("exit loop senddata!!!"); break;
			}
			writeByte(sendbuffer[i]);
			count++;
		}
		wait_deselect();
		setSlaveReady(false);
		//	trace("done sending " + String(count) + " bytes.");


	}
	else // data (sendbuffer) -> oric
	{
		setSlaveReady(true);
		wait_select();
		for (int i = 0; i < size; i++)
		{
			if (digitalRead(_SS)) {
				trace("exit loop senddata!!!"); break;
			}
			byte b = data[i];
			//b = i % 8 + 16;

			crc += b;
			writeByte(b);
			count++;
		}
		wait_deselect();
		setSlaveReady(false);
	}
	//	 trace("done sending "+String(count)+" bytes.");

	return crc;
}



inline String receiveString()
{
	byte b = 0, index = 0;
	stringbuff[0] = 0;
	wait_select();
	do
	{
		if (digitalRead(_SS)) {
			trace("exit loop receiveString!!!"); break;
		}
		b = readByte();
		stringbuff[index++] = b;
	} while (b);
	wait_deselect();

	if (stringbuff[0])
		trace("received : " + (String)stringbuff);
	else
	{
		trace("received : {" + String((int)stringbuff[0]) + "}");
		sendTerminator(0);
	}

	return (String)stringbuff;
}

inline void writeInteger(unsigned int i)
{
	writeByte(i >> 8);
	writeByte(i & 0xff);
}

inline void sendInteger(unsigned int x)
{
	wait_select();
	writeByte(x >> 8);
	writeByte(x & 0xff);
	wait_deselect();
}
inline void sendByte(byte i)
{
	wait_select();
	writeByte(i);
	wait_deselect();
}

inline unsigned int readInteger()
{
	unsigned int res = readByte() << 8;
	return res | readByte();
}

inline unsigned int receiveInteger()
{
	wait_select();
	unsigned int res = readByte() << 8;
	res |= readByte();
	wait_deselect();

	return res;
}

// max 255 len 0 terminated string
inline void sendString(String s)
{
	trace("sending : " + s);

	setSlaveReady(true);
	wait_select();
	unsigned int i = 0;
	while (s[i])
	{
		if (digitalRead(_SS)) {
			trace("exit loop sendString!!!"); break;
		}
		if (s[i] == 9)
		{
			s[i] = ' ';
			//writeByte(' '); !!!! surtout pas change la taille sur le recepteur
		}
		writeByte(s[i++]);
	}
	writeByte(0);

	wait_deselect();
	setSlaveReady(false);
	//delay(50);
}

// CUSTOM STRING BUFFER WRITING ...  
int pos = 0;
// output no 0 end !!!
void write(String s)
{
	Serial.print(s);
	byte b = 1, index = 0;

	while (1)
	{
		b = s[index++];
		if (b)
		{
			stringbuff[pos++] = b;
			if (pos == 255)
			{
				stringbuff[255] = 0;
				pos = 0;
				sendString(stringbuff);
			}
		}
		else
			break;
	}
}

void writeln()
{
	Serial.println("");

	stringbuff[pos++] = '\r';
	if (pos == 255)
	{
		pos = 0;
		sendString(stringbuff);
	}
	stringbuff[pos++] = '\n';
	if (pos == 255)
	{
		pos = 0;
		sendString(stringbuff);
	}
}
// exemple :
//234567890123456789012345678901234567890
//
//ANAARMA1.BIN 99999B ANAARMA2.BIN  8000B
//
//
//

#define ORIC_BLACK	0
#define ORIC_RED	1
#define ORIC_GREEN	2
#define ORIC_YELLOW 3
#define ORIC_BLUE   4
#define ORIC_MAGENTA 5
#define ORIC_CYAN 6
#define ORIC_WHITE 7;

// print dir to buffer
void printDirectory(File dir, int numTabs) {
	while (true) {

		File entry = dir.openNextFile();
		if (!entry) {
			// no more files
			break;
		}
		char bufff[3];

		int color;

		if (!entry.isDirectory())
		{
			total_files++;

			char *en = (char*)(entry.name());

			String str = String(en);

			int dot = str.lastIndexOf(".");

			// *.BIN    3
			// *.EXE	6
			// *.COM	6
			// *.TXT	5
			// *.*		7
			// directory 2

			if (dot > -1)
			{
				String ext = str.substring(dot + 1).toUpperCase();
				if (ext.equals("BIN")) color = ORIC_GREEN;
				else if (ext.equals("EXE")) color = ORIC_BLUE;
				else if (ext.equals("COM")) color = ORIC_CYAN;
				else if (ext.equals("TXT")) color = ORIC_YELLOW;
				else  color = ORIC_RED;

			}
			else
				color = ORIC_WHITE;
		}
		else
		{
			total_dirs++;
			color = ORIC_MAGENTA;
		}

		bufff[0] = 27;
		bufff[1] = color + 64;
		bufff[2] = 0;

		write(bufff);


		for (uint8_t i = 0; i < numTabs; i++) {
			write("-");
		}
		write(entry.name());
		if (entry.isDirectory()) {
			total_bytes += entry.size();
			write("/");
			for (unsigned int i = 0; i < 19 - strlen(entry.name()) - 6 - numTabs; i++)
				write(".");
			write("[dir]");
			//printDirectory(entry, numTabs + 1);
		}
		else {
			// files have sizes, directories do not
			String s = String(entry.size(), 10);
			total_bytes += entry.size();
			for (unsigned int i = 0; i < 19 - strlen(entry.name()) - s.length() - numTabs; i++)
				write(".");
			write(s);


		}
		entry.close();
	}
}
// print dir to serial
void printDirectorySerial(File dir, int numTabs) {
	while (true) {

		File entry = dir.openNextFile();
		if (!entry) {
			// no more files
			//Serial.println("**nomorefiles**");
			break;
		}
		for (uint8_t i = 0; i < numTabs; i++) {
			Serial.print('\t');
		}
		Serial.print(entry.name());
		if (entry.isDirectory()) {
			Serial.println("/");
			printDirectorySerial(entry, numTabs + 1);
		}
		else {
			// files have sizes, directories do not
			Serial.print("\t\t");
			Serial.println(entry.size(), DEC);
		}
		entry.close();
	}
}
Sd2Card card;
SdVolume volume;
SdFile roote;
void printCardInfo()
{

	if (!card.init(SPI_HALF_SPEED * 2, chipSelect)) {
		write("initialization failed. Things to check:"); writeln();
		write("* is a card inserted?"); writeln();
		write("* is your wiring correct?"); writeln();
		write("* did you change the chipSelect pin to match your shield or module?"); writeln();
		return;
	}
	else {
		write("Wiring is correct and a card is present."); writeln();
	}

	// print the type of card
	write("Card type: ");
	switch (card.type()) {
	case SD_CARD_TYPE_SD1:
		write("SD1"); writeln();
		break;
	case SD_CARD_TYPE_SD2:
		write("SD2"); writeln();
		break;
	case SD_CARD_TYPE_SDHC:
		write("SDHC"); writeln();
		break;
	default:
		write("Unknown"); writeln();
	}

	// Now we will try to open the 'volume'/'partition' - it should be FAT16 or FAT32
	if (!volume.init(card)) {
		write("Could not find FAT16/FAT32 partition.\nMake sure you've formatted the card"); writeln();
		return;
	}


	// print the type and size of the first FAT-type volume
	uint32_t volumesize;
	write("Volume type is FAT");
	write(String(volume.fatType(), DEC)); writeln();
	writeln();


	volumesize = volume.blocksPerCluster();    // clusters are collections of blocks
	volumesize *= volume.clusterCount();       // we'll have a lot of clusters
	if (volumesize < 8388608ul) {
		write("Volume size (bytes): ");
		write(volumesize * 512);  writeln();      // SD card blocks are always 512 bytes
	}
	write("Volume size (Kbytes): ");
	volumesize /= 2;
	write(volumesize); writeln();
	write("Volume size (Mbytes): ");
	volumesize /= 1024;
	write(volumesize); writeln();


	//	write("Files found on the card (name, date and size in bytes): ");
//	roote.openRoot(volume);

	// list all files in the card with date and size
//	roote.ls(LS_R | LS_DATE | LS_SIZE);

//	roote.close();

}

void setup() {
	// put your setup code here, to run once:

	// teensy in slave mode !
	Serial.begin(2000000);
	while (!Serial);
	trace("mandel starts");
	mandel();
	trace("mandel ends");

#if TRACE
	for (int i = 0; i < m; i++) pinMode(2 + i, INPUT);

#else
	Serial.print("Initializing SD card....");

	SPI.setMISO(11);
	SPI.setMOSI(12);
	SPI.setSCK(13);



	if (!SD.begin(chipSelect)) {
		Serial.println("initialization failed!");
		Serial.flush();

		return;
	}
	Serial.println("initialization done.");

	root = SD.open("/");

	//	printDirectorySerial(root, 0);

	Serial.println("done!");
	root.close();



	pinMode(_SS, INPUT);
	pinMode(_SCLK, INPUT);
	pinMode(_MOSI, INPUT);
	pinMode(_MISO, OUTPUT);


	Serial.flush();
	setSlaveReady(false);
	trace("go");
	cli();
#endif


}

struct ORIC_BINARY
{
	unsigned int address;
	unsigned int size;
	unsigned char flags;
};

void sendDataHeader(unsigned int address, unsigned int size, unsigned char flags)
{
	Serial.println("header:" + String(address, HEX) + "," + String(size, HEX) + "," + String(flags));
	setSlaveReady(true);
	wait_select();
	writeInteger(address);
	writeInteger(size);
	writeByte(flags); // hires mode
	wait_deselect();
	setSlaveReady(false);
}

void sendCRC(unsigned int crc)
{
	Serial.print("send crc ");
	Serial.println(crc & 65535, HEX);
	setSlaveReady(true);
	sendInteger(crc);
	setSlaveReady(false);
}

void sendTerminator(byte terminator)
{
	setSlaveReady(true);
	sendByte(terminator);
	setSlaveReady(false);
}
String readREQ()
{
	setSlaveReady(true);
	String req = receiveString();
	setSlaveReady(false);
	return req;
}
void sendDirResponse()
{
	sendString("OK DIR");		//resp
	total_bytes = 0;
	total_files = 0;
	total_dirs = 0;

	pos = 0;
	//    "0123456789012345678901234567890123456
	printCardInfo();
	writeln();
	write(" ========== SD CARD CONTENTS ===========");
	root = SD.open("/");
	unsigned long avail = root.availableForWrite();

	printDirectory(root, 0);


	//	printDirectorySerial(root, 0);
	root.close();

	writeln();
	write(" ---------------------------------------");
	write(" USED : " + String(total_bytes));
	writeln();



	write(" AVAILABLE : " + String(avail));
	writeln();
	write(" TOTAL FILES : " + String(total_files));
	writeln();
	write(" TOTAL DIRS : " + String(total_dirs));
	writeln();
	write(" =======================================");

	stringbuff[pos++] = 0;

	sendString(stringbuff);		//stringresp

	delay(5000);
	if (stringbuff[0])
		sendTerminator(0);

}

void sendTapeResponse(char *name, bool sleep)
{
	trace("sending tape \"" + String(name) + "\"");

	// exists ?
	if (!SD.exists(name))
	{
		sendResponse("NOK TAPE", "File not found:" + String(name));
		return;

	}
	else
	{

		File dataFile = SD.open(name);


		if (dataFile)
		{
			sendString("OK LOADING \"" + String(name) + "\"");  // resp
			delay(3000);
			crc = 0;
			unsigned int size = dataFile.size();
			byte header[32];

			//dataFile.readBytes(header, 0x12);

			// 0  1  2  3  4  5  6  7  8  9  a  b  c  d  e  f  10 11
			// 16 16 16 24 00 00 80 C7 8D 28 05 00 00 4F 53 44 48 00
			// 16 16 16 24 00 FF 80 00 BF 3F A0 00 00 6F 7A 61 72 74 73 65 74 63 47 65 6F 72 67 65 50 00
			//             0  1  2  3  4  5  6  7  8  9  a  b        
			while (1)
			{
				dataFile.readBytes(header, 1);
				if (header[0] != 0x16)
					break;
			}

			if (header[0] != 0x24)
			{
				trace("file header error");
				return;
			}


			/*    Dim array_type1 As Byte = BUFFER(x + 1)
                Dim array_type2 As Byte = BUFFER(x + 2)
                Dim program_type As Byte = BUFFER(x + 3)
                Dim auto_indicator As Byte = BUFFER(x + 4)
                Dim end_address As Integer = 256 * BUFFER(x + 5) + BUFFER(x + 6)
                Dim start_address As Integer = 256 * BUFFER(x + 7) + BUFFER(x + 8)
				*/

			dataFile.readBytes(header, 9);
			 	for (int i = 0; i < 9; i++)
			trace(String(i) + " : " + String(header[i], HEX)); 
			unsigned short start_address = (header[6] << 8)+ header[7] ;
			byte auto_indicator = header[3];
			unsigned short end_address =  (header[4] << 8)+header[5] ;
			unsigned short length = end_address - start_address + 1;

#define KIND_CODE_OR_BLOC 0x80
#define KIND_ARRAY 0x40
#define KIND_BASIC 0x00
			byte kind = header[2];
			 
			byte program_type = header[3];

			trace("start=" + String(start_address, HEX));
			trace("length=" + String(length, HEX));
			trace("programtype=" + String(program_type, HEX));
			trace("programkind=" + String(kind, HEX));
			trace("autoindicator=" + String(auto_indicator, HEX));
			while (1) {
				dataFile.readBytes(header, 1);
				if (!header[0]) break;
			}

			trace("position=" + String(dataFile.position()));

			byte tapebuffer[256];

			trace("write header");

			sendDataHeader(start_address, length, program_type);

			trace("send data");

			size = length;
			crc = 0;
			count = 0;
			unsigned long t1 = micros();

			while (size != 0) {
				//trace("size=" + String(size, HEX));

				if (size < 256)
				{
					dataFile.readBytes(tapebuffer, size);
					sendData(tapebuffer, size, false);
					size = 0;
				}
				else
				{

					dataFile.readBytes(tapebuffer, 256);
					sendData(tapebuffer, 256, false);
					size -= 256;
				}
			}
			printBauds(micros() - t1, length);
			trace("count=" + String(count) + " bytes written.");

			dataFile.close();

			trace(String(micros() - t1) + " µs");
			trace("length=" + String(length));

			sendCRC(crc);

			if (program_type == 0xc7 || program_type == 0x04)
			{
				if (sleep)
				{
					digitalWrite(_MISO, LOW);
					pinMode(_MISO, INPUT);
					trace("sleeping");
					while (1) {
						Serial.print(".");
						Serial.flush();

						delay(5000);
					}
				}
			}

		}
	}

}
void sendResponse(String resp, String message)
{
	sendString(resp);
	sendString(message);
	sendTerminator(0);
}

int numi = 80;

void loop()
{

#if TRACE
	trace2();
	// delayMicroseconds(10);
#else

	String req = readREQ();


	if (req.equals("DIR"))
	{

		sendDirResponse();
		return;
	}

	if (req.equals("BOOT"))
	{

		sendTapeResponse("oric_spi.tap", true);


		return;
	}
	if (req.equals("TAPE"))
	{
	//	sendTapeResponse("sinust~1.tap", true);
	//	return;
//	sendTapeResponse("SCARLET.TAP", true);
//	return;
		// ok sendTapeResponse("cycltron.tap",true);

	   sendTapeResponse("manic.tap", true);
	// sendTapeResponse("spi_load.tap", false); // loop infinite finissant par finalement planter.. ou bugger 

			// ok !!!!!!! sauf le son deconne a bloc sur cet oric ! :(	sendTapeResponse("nabdc.tap", true);

		 	return;

		String path = "images/imag";
		if (numi < 100)
			path += "e" + String(numi);
		else
			if (numi < 1000)
				path += String(numi);

		path += ".tap";
		numi++;
		if (numi > 120) numi = 0;

		int i;
		for (i = 0; i < path.length(); i++)
			stringbuff[i] = path[i];
		stringbuff[i] = 0;

		sendTapeResponse(stringbuff, false);

		return;
	}


	if (req.equals("TEXT"))
	{
		if (ana > 1)
		{
			sendResponse("NOK TEXT", "no text !!!!");
			return;
		}

		sendString("OK TEXT LOADING \"VIA.TXT\"");

		File dataFile = SD.open("VIA2.TXT");

		for (int dec = 255; dec > 0; dec--)
		{
			//trace("dec="); Serial.println(dec);

			while (dataFile.available() > dec)
			{
				dataFile.readBytes(stringbuff, dec);
				stringbuff[dec] = 0; //0..254=s/255=0.....
				sendString(stringbuff);		//stringresp

			}
		}
		if (stringbuff[0])
			sendTerminator(0);

		dataFile.close();

		return;
	}
	if (req.equals("SAVE"))
	{
		 	if (ana > 1)
			{
				sendResponse("NOK SAVE", "disabled...");
				return;
			}
	 
	// exists ?



		sendString("OK SAVE PROGMEM->ORIC");


		sendDataHeader(0xa000, 8000, 0x02);

		crc = 0; count = 0;


		unsigned long t1 = micros();
		for (int i = 0; i < 8000; i += 200)
		{
			sendData(img + i, 200, true);
		//	sendData(oric_screen + i, 200, true);


		}
		unsigned long t2 = micros() - t1;
		t2 = micros() - t1;
		printBauds(t2, 8000);
		trace("count=" + String(count) + " bytes written.");


		sendCRC(crc);

		Serial.print("elapsed="); Serial.println(t2);
		Serial.print("progmem sum="); Serial.println(crc, HEX);
		Serial.print("progmem sum(16bit)="); Serial.println(crc, HEX);
		Serial.print("bauds="); Serial.println(String(64000000000.0 / t2));

		return;

	}
	if (req.equals("LOAD"))
	{
		/*sendString("NOK LOAD");
		sendString("Ana de Armas !");
		stringbuff[0] = 0;
		sendString(stringbuff);
		return;*/
		char name[] = "ANAARMA0.BIN";
		name[7] = '0' + ana++;
		if (ana == 10) ana = 1;

		// exists ?
		if (!SD.exists(name))
		{
			sendResponse("NOK LOAD ", "SD File not found:" + String(name));
			return;

		}
		else
		{
			File dataFile = SD.open(name);


			if (dataFile)
			{

				sendString("OK LOADING \"" + String(name)+"\"");  // resp
				sendDataHeader(0xa000, 8000, 0x02);

				crc = 0;
				unsigned int size = 8000;
				count = 0;
				unsigned long t1 = micros();

				while (size != 0) {
					//Serial.print("remaining bytes to send : "); Serial.println(size);
					if (size < 200)
					{
						dataFile.readBytes(linebuffer, size);
						sendData(linebuffer, size, false);
						size = 0;
					}
					else
					{
						dataFile.readBytes(linebuffer, 200);
						sendData(linebuffer, 200, false);
						size -= 200;
					}

				}
				unsigned long t2 = micros() - t1;
				printBauds(t2, 8000);
				trace("count=" + String(count) + " bytes written.");


				dataFile.close();
				delay(1000);

				sendCRC(crc);

				Serial.print("crc="); Serial.println(crc);
				Serial.flush();
				Serial.print("elapsed="); Serial.println(t2);
				Serial.print("bauds="); Serial.println(String(64000000000.0 / t2));

				return;
			}
			else
			{
				sendResponse("NOK LOAD", "Error opening datafile");
				return;

			}
		}

	}

	if (req[0] != 0 && req[0] < 128)
	{
		sendResponse("NOK UNKNOWN", "UNKNOWN REQUEST");
		return;

	}
	else
	{
		trace("sending 0");
		sendTerminator(0);
		return;
	}

#endif
}



